/*
 * Copyright Akkodis Edge Sweden AB
 *
 * The code contained herein is licensed under the GNU General Public
 * License. You may obtain a copy of the GNU General Public License
 * Version 2 or later at the following locations:
 *
 * http://www.opensource.org/licenses/gpl-license.html
 * http://www.gnu.org/copyleft/gpl.html
 */

/dts-v1/;

#include "imx6q.dtsi"
#include "ce-imx6-01.dtsi"

/ {
	model = "CE-IMX6-01 - Quad";
	compatible = "ake,ce-imx6-01-q", "fsl,imx6q";

	memory@10000000 {
		device_type = "memory";
		reg = <0x10000000 0xF0000000>;
	};
};
