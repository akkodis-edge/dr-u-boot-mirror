/*
 * Copyright Akkodis Edge Sweden AB
 *
 * The code contained herein is licensed under the GNU General Public
 * License. You may obtain a copy of the GNU General Public License
 * Version 2 or later at the following locations:
 *
 * http://www.opensource.org/licenses/gpl-license.html
 * http://www.gnu.org/copyleft/gpl.html
 */

/dts-v1/;

#include "imx6dl.dtsi"
#include "ce-imx6-01.dtsi"

/ {
	model = "CE-IMX6-01 - DualLite";
	compatible = "ake,ce-imx6-01-dl", "fsl,imx6dl";

	memory@10000000 {
		device_type = "memory";
		reg = <0x10000000 0x40000000>;
	};
};

&i2c4 {
	status = "disabled";
};

&epdc {
	status = "disabled";
};

